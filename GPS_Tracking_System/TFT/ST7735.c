#include"../utils/STD_types.h"
#include"../mcal/PortDriver/port.h"
#include"../mcal/PortDriver/port_types.h"
#include"../mcal/dio/dio.h"
#include"../mcal/ssi/ssi.h"
#include"../Service/Delay_ms/Delay_ms.h"
//*****************************************************************************
//
// Screen commands
//
//*****************************************************************************

#define ST7735_NOP     0x00
#define ST7735_SWRESET 0x01
#define ST7735_RDDID   0x04
#define ST7735_RDDST   0x09

#define ST7735_SLPIN   0x10
#define ST7735_SLPOUT  0x11
#define ST7735_PTLON   0x12
#define ST7735_NORON   0x13

#define ST7735_INVOFF  0x20
#define ST7735_INVON   0x21
#define ST7735_DISPOFF 0x28
#define ST7735_DISPON  0x29
#define ST7735_CASET   0x2A
#define ST7735_RASET   0x2B
#define ST7735_RAMWR   0x2C
#define ST7735_RAMRD   0x2E

#define ST7735_PTLAR   0x30
#define ST7735_COLMOD  0x3A
#define ST7735_MADCTL  0x36

#define ST7735_FRMCTR1 0xB1
#define ST7735_FRMCTR2 0xB2
#define ST7735_FRMCTR3 0xB3
#define ST7735_INVCTR  0xB4
#define ST7735_DISSET5 0xB6

#define ST7735_PWCTR1  0xC0
#define ST7735_PWCTR2  0xC1
#define ST7735_PWCTR3  0xC2
#define ST7735_PWCTR4  0xC3
#define ST7735_PWCTR5  0xC4
#define ST7735_VMCTR1  0xC5

#define ST7735_RDID1   0xDA
#define ST7735_RDID2   0xDB
#define ST7735_RDID3   0xDC
#define ST7735_RDID4   0xDD

#define ST7735_PWCTR6  0xFC

#define ST7735_GMCTRP1 0xE0
#define ST7735_GMCTRN1 0xE1

#define MADCTL_MY  0x80
#define MADCTL_MX  0x40
#define MADCTL_MV  0x20
#define MADCTL_ML  0x10
#define MADCTL_RGB 0x00
#define MADCTL_BGR 0x08
#define MADCTL_MH  0x04

//*****************************************************************************
//
// Colour Definitions
//
//*****************************************************************************
#define	ST7735_BLACK   0x0000
#define	ST7735_RED     0x001F
#define	ST7735_BLUE    0xF800
#define	ST7735_GREEN   0x07E0
#define ST7735_CYAN    0x07FF
#define ST7735_MAGENTA 0xF81F
#define ST7735_YELLOW  0xFFE0  
#define ST7735_WHITE   0xFFFF

static uint8 GMCTRP1_arr[16]={0x02, 0x1c, 0x07, 0x12,
                              0x37, 0x32, 0x29, 0x2d,
                              0x29, 0x25, 0x2B, 0x39,
                              0x00, 0x01, 0x03, 0x10};

static uint8 GMCTRN1_arr[16]={0x03, 0x1d, 0x07, 0x06,
                              0x2E, 0x2C, 0x29, 0x2D,
                              0x2E, 0x2E, 0x37, 0x3F,
                              0x00, 0x00, 0x02, 0x10};

static const unsigned char font[] = 
{
  0x00, 0x00, 0x00, 0x00, 0x00,   
  0x3E, 0x5B, 0x4F, 0x5B, 0x3E,   
  0x3E, 0x6B, 0x4F, 0x6B, 0x3E,   
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  0x00, 0x00, 0x00, 0x00, 0x00
};

/*static*/ void writeCommand(uint8 Command)
{

  Dio_WriteChannel(Port_Channel_A6,STD_low);
  SSI_SEND_BYTE(Command);

}

static void writeData(uint8 Data)
{
 
  Dio_WriteChannel(Port_Channel_A6,STD_high);
  SSI_SEND_BYTE(Data);
}
static void write_Array_Of_Data(uint8* Pntr_To_array_of_data,uint8 size)
{
  Dio_WriteChannel(Port_Channel_A6,STD_high);
  SSI_SEND_ARRAY_OF_BYTES(Pntr_To_array_of_data,size);
}
void ST7735_Init(void)
{
    /**Hardware Reset**/
  
      Dio_WriteChannel(Port_Channel_A7,STD_low);
      delay_ms(500);
      Dio_WriteChannel(Port_Channel_A7,STD_high);
      delay_ms(500);

    /**Software Reset**/
  
    /*-If Software Reset is applied during Sleep In mode, it will be necessary to wait 120msec before sending next command.
      -The display module loads all default values to the registers during 120msec.
      -If Software Reset is applied during Sleep Out or Display On Mode, it will be necessary to wait 120msec before sending
        next command.
     */

    writeCommand(ST7735_SWRESET);
    delay_ms(150);
    
    /**Sleep Out**/
    
    /*-This command turns off sleep mode.
      -In this mode the DC/DC converter is enabled, Internal display oscillator is started, and panel scanning is started.
     */
    writeCommand(ST7735_SLPOUT);
    delay_ms(255);
    
    /**Interface Pixel Format**/
    
    /* This command is used to define the format of RGB picture data, which is to be transferred via the
       MCU interface. The formats are shown in the table:
       IFPF[2:0] MCU Interface Color Format
        ______________________
       |011 | 3 | 12-bit/pixel|
       |101 | 5 | 16-bit/pixel|
       |110 | 6 | 18-bit/pixel|
       |111 | 7 | No used     |
       ------------------------
        Note1: In 12-bit/Pixel, 16-bit/Pixel or 18-bit/Pixel mode, the LUT is applied to transfer data into the Frame Memory.
        Note2: The Command 3Ah should be set at 55h when writing 16-bit/pixel data into frame memory, but 3Ah should be
        re-set to 66h when reading pixel data from frame memory. Please check the LUT in chapter 9.17 when using
        memory read function.
     */

    
     writeCommand(ST7735_COLMOD);
     /*choosen paramter : 5-> 16-bit/pixel*/
     writeData(0x05);
     
     /**Normal Display Mode On**/
    
    /*-This command returns the display to normal mode.
      -Normal display mode on means Partial mode off.
      -Exit from NORON by the Partial mode On command (12h)
      �-� Don�t care*/
     
     /*writeCommand(ST7735_NORON);*/
     
     /**Memory Data Access Control**/
    /* This command defines read/ write scanning direction of frame memory.*/
     writeCommand(ST7735_MADCTL);
     writeData(0xc8);
     /**Gamma (�+�polarity) Correction Characteristics Setting**/
     
     writeCommand(ST7735_GMCTRP1);
     write_Array_Of_Data(GMCTRP1_arr,16);
     /**Gamma �-�polarity Correction Characteristics Setting**/

     writeCommand(ST7735_GMCTRN1);
     write_Array_Of_Data(GMCTRN1_arr,16);
     
    /**Display On**/
    /*This command is used to recover from DISPLAY OFF mode. Output from the Frame Memory is enabled.
    - This command makes no change of contents of frame memory.
    - This command does not change any other status.
    - The delay time between DISPON and DISPOFF needs 120ms at least*/
    writeCommand(ST7735_DISPON);
    delay_ms(100);
      
}
/*Define the dimension of window that you want to draw in it */
void Define_Window(uint8 X_S ,uint8 Y_S ,uint8 X_E ,uint8 Y_E)
{
     /**Column Address Set**/ 
     writeCommand(ST7735_CASET);  
     writeData(0x00);
     writeData(X_S);
     writeData(0x00);
     writeData(X_E);
     /**Row Address Set**/     
     writeCommand(ST7735_RASET);  
     writeData(0x00);
     writeData(Y_S);
     writeData(0x00);
     writeData(Y_E);
     /**Memory Write**/
     writeCommand(ST7735_RAMWR);  
}
void pushColour(uint16 colour) 
{
     writeData(colour>>8);  
     writeData(colour);  
}
void ST7735_drawPixel(uint8 x, uint8 y, uint16 colour_16_BIT) 
{
      if((x < 0) || (y < 0)) return;
      
      Define_Window(x,y,x+1,y+1);
      pushColour(colour_16_BIT);
}
void ST7735_fillRect( uint16 x, uint16 y, uint16 w, uint16 h,uint16 colour) 
{
  Define_Window(x,y,x+w-1,y+h-1);

  for(y=h; y>0; y--) 
  {
      for(x=w; x>0; x--) 
      {
          pushColour(colour);
      }
  }
}

void ST7735_Draw_image( uint8* image_8bit_rep_pntr) 
{

  Define_Window(0,12,127,127);

  int i=0;
  for(;i<(29440);i++) 
  {
    writeData(image_8bit_rep_pntr[i]);
  }

}

void ST7735_drawChar(uint16 x, uint16 y, unsigned char c,uint16 colour, uint16 bg, uint8 size) 
{

  if(((x + 6 * size - 1) < 0)  || ((y + 8 * size - 1) < 0))  return;

  for (uint8 i=0; i<6; i++ ) 
  {
      uint8 line;
      
      if (i == 5) 
      {
          line = 0x0;
      }
      else 
      {
          line = *(font+(c*5)+i);
              
          for (uint8 j = 0; j<8; j++) 
          {
              if (line & 0x1) 
              {
                      if (size == 1) // default size
                      {
                        ST7735_drawPixel(x+i, y+j, colour);
                      }
                      else 
                      {  
                        // big size
                        ST7735_fillRect(x+(i*size), y+(j*size), size, size, colour);
                      } 
              } 
              else if (bg != colour) 
              {
                      if (size == 1) // default size
                      {
                         ST7735_drawPixel(x+i, y+j, bg);
                      }
                      else 
                      {  
                          // big size
                          ST7735_fillRect(x+i*size, y+j*size, size, size, bg);
                      }
              }
              line >>= 1;
          }
      }
  }
}
void ST7735_drawString(char *c, uint16 x, uint16 y, uint16 colour, uint16 bg, uint8 size) 
{
  uint16 cursor_x = x;
  uint16 cursor_y = y;
  uint8 textsize = size;
  uint16 textcolour = colour;
  uint16 textbgcolour = bg;

  while(*c) 
  {
        if (*c == '\n') 
        {
            cursor_y += textsize*8;
            cursor_x  = 0;
        } 
	else if (*c == '\r') 
	{
         // Skip
        } 
	else 
	{
            ST7735_drawChar(cursor_x, cursor_y, *c, textcolour, textbgcolour, textsize);
            cursor_x += textsize*6;

        }
        c++;
  }
}
